## backend/packages/extlinux/Config.in
```kconfig
config BR2_PACKAGE_EXTLINUX
	bool "extlinux"
	help
	  SYSLINUX boot loader
	  http://www.kernel.org/pub/linux/utils/boot/syslinux/
```

## backend/packages/gnutls/Config.in
```kconfig
config BR2_PACKAGE_GNUTLS
	bool "gnutls"
	help
	  The GNU Transport Layer Security Library.
	  http://ftp.gnu.org/gnu/gnutls
```

## backend/packages/monit/Config.in
```kconfig
config BR2_PACKAGE_MONIT
	bool "monit"
	help
	  Monit is linux system watchdog
	  http://www.mmonit.com/monit
```

## backend/packages/msmtp/Config.in
```kconfig
config BR2_PACKAGE_MSMTP
	bool "msmtp"
	help
	  msmtp mini mailer daemon.
	  http://msmtp.sourceforge.net
```

## backend/packages/pacman/Config.in
```kconfig
config BR2_PACKAGE_PACMAN
	bool "pacman"
	help
	  Pacman is a linux pkg manager
	  www.archlinux.org/pacman
```

## backend/packages/sdkbinutils/Config.in
```kconfig
config BR2_PACKAGE_SDKBINUTILS
	bool "sdkbinutils"
	help
	  The GNU Binutils are a collection of binary tools:
	  ld - the GNU linker.
	  as - the GNU assembler.
	  and others...
	  http://www.gnu.org/software/binutils/
```

## backend/packages/sdkgcc/Config.in
```kconfig
config BR2_PACKAGE_SDKGCC
	bool "sdkgcc"
	help
	  The GNU gcc compiler:
	  http://www.gnu.org/software/gcc/
```

## backend/packages/sdkgmp/Config.in
```kconfig
config BR2_PACKAGE_SDKGMP
	bool "sdkgmp"
	help
	  GNU Multiple Precision Arithmetic Library.
	  http://gmplib.org/
```

## backend/packages/sdkmpc/Config.in
```kconfig
config BR2_PACKAGE_SDKMPC
	bool "sdkmpc"
	select BR2_PACKAGE_SDKMPFR
	select BR2_PACKAGE_SDKGMP
	help
	  Mpc is a C library for the arithmetic of complex numbers with
	  arbitrarily high precision and correct rounding of the result.
	  It is built upon and follows the same principles as Mpfr.
	  http://www.multiprecision.org/
```

## backend/packages/sdkmpfr/Config.in
```kconfig
config BR2_PACKAGE_SDKMPFR
	bool "sdkmpfr"
	select BR2_PACKAGE_SDKGMP
	help
	  C library for multiple-precision floating-point computations
	  with exact rounding.
	  http://www.mpfr.org/
```

## backend/packages/sshpass/Config.in
```kconfig
config BR2_PACKAGE_SSHPASS
	bool "sshpass"
	help
	  sshpass let you use a password for ssh over commandline for scripts.
	  http://sshpass.sourceforge.net
```

## backend/packages/swraid/Config.in
```kconfig
config BR2_PACKAGE_SWRAID
	bool "swraid"
	help
	  Utility for managing RAID hardware.
	  http://cgi.cse.unsw.edu.au/~neilb/mdadm
```

## backend/packages/volmgr/Config.in
```kconfig
config BR2_PACKAGE_VOLMGR
        bool "volmgr"
        help
          This is LVM2, the rewrite of The Linux Logical Volume Manager.
          LVM supports enterprise level volume management of disk and disk
          subsystems by grouping arbitrary disks into volume groups. The total
          capacity of volume groups can be allocated to logical volumes, which
          are accessed as regular block devices.
          The Linux Kernel Device Mapper is the LVM
          (Linux Logical Volume Management) Team's implementation of a
          minimalistic kernel-space driver that handles volume management,
          while keeping knowledge of the underlying device layout in
          user-space. This makes it useful for not only LVM, but EVMS,
          software raid, and other drivers that create "virtual" block devices.
```
